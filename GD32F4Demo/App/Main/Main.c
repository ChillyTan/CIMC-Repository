/*********************************************************************************************************
* 模块名称：Main.c
* 摘    要：主文件，包含软硬件初始化函数和main函数
* 当前版本：1.0.0
* 作    者：Leyutek(COPYRIGHT 2018 - 2022 Leyutek. All rights reserved.)
* 完成日期：2022年01月01日
* 内    容：
* 注    意：注意勾选Options for Target 'Target1'->Code Generation->Use MicroLIB，否则printf无法使用
**********************************************************************************************************
* 取代版本：
* 作    者：
* 完成日期：
* 修改内容：
* 修改文件：
*********************************************************************************************************/

/*********************************************************************************************************
*                                              包含头文件
*********************************************************************************************************/
#include "Main.h"
#include "gd32f470x_conf.h"
#include "SysTick.h"
#include "RCU.h"
#include "NVIC.h"
#include "Timer.h"
#include "LED.h"
#include "UART0.h"
#include "KeyOne.h"
#include "ProcKeyOne.h"
#include "OLED.h"
#include "RTC.h"
#include "SPI_FLASH.h"

/*********************************************************************************************************
*                                              宏定义
*********************************************************************************************************/

/*********************************************************************************************************
*                                              枚举结构体
*********************************************************************************************************/

/*********************************************************************************************************
*                                              内部变量定义
*********************************************************************************************************/

/*********************************************************************************************************
*                                              内部函数声明
*********************************************************************************************************/
static void InitHardware(void);   //初始化硬件相关的模块
static void InitSoftware(void);   //初始化软件相关的模块
static void Proc2msTask(void);    //2ms处理任务
static void Proc1SecTask(void);   //1s处理任务

/*********************************************************************************************************
*                                              内部函数实现
*********************************************************************************************************/
/*********************************************************************************************************
* 函数名称：InitHardware
* 函数功能：所有的硬件相关的模块初始化函数都放在此函数中
* 输入参数：void
* 输出参数：void
* 返 回 值：void
* 创建日期：2022年01月01日
* 注    意：
*********************************************************************************************************/
static  void  InitHardware(void)
{  
  SystemInit();        //系统初始化
  InitRCU();           //初始化RCU模块
  InitNVIC();          //初始化NVIC模块
  InitTimer();         //初始化Timer模块
  InitSysTick();       //初始化SysTick模块
	InitLED();           //初始化LED模块
  InitUART0(115200);   //初始化UART模块
  InitKeyOne();        //初始化按键模块
  InitProcKeyOne();    //初始化按键处理模块
	OLED_Init();         //初始化OLED模块
	RTC_Init();          //初始化RTC模块
	spi_flash_init();    //初始化SPI_FLASH模块
}

/*********************************************************************************************************
* 函数名称：InitSoftware
* 函数功能：所有的软件相关的模块初始化函数都放在此函数中
* 输入参数：void
* 输出参数：void
* 返 回 值：void
* 创建日期：2022年01月01日
* 注    意：
*********************************************************************************************************/
static  void  InitSoftware(void)
{
	
}

/*********************************************************************************************************
* 函数名称：Proc2msTask
* 函数功能：2ms处理任务 
* 输入参数：void
* 输出参数：void
* 返 回 值：void
* 创建日期：2022年01月01日
* 注    意：
*********************************************************************************************************/
static  void  Proc2msTask(void)
{  
  static u8 s_Cnt5 = 0;
  unsigned char recData;
  
  if(Get2msFlag())  //判断2ms标志位状态
  { 
    LEDFlicker(250);//调用闪烁函数
    
    //20ms任务
    if(s_Cnt5 >= 4)
    {
      ScanKeyOne(KEY_NAME_KEY1, ProcKeyUpKey1, ProcKeyDownKey1);
      ScanKeyOne(KEY_NAME_KEY2, ProcKeyUpKey2, ProcKeyDownKey2);
      ScanKeyOne(KEY_NAME_KEY3, ProcKeyUpKey3, ProcKeyDownKey3);

      s_Cnt5 = 0;
    }
    else
    {
      s_Cnt5++;
    }

    while(ReadUART0(&recData, 1))
    {
      recData++;
     
      WriteUART0(&recData, 1);
    }

    Clr2msFlag();   //清除2ms标志位
  }
}

/*********************************************************************************************************
* 函数名称：Proc1SecTask
* 函数功能：1s处理任务 
* 输入参数：void
* 输出参数：void
* 返 回 值：void
* 创建日期：2022年01月01日
* 注    意：
*********************************************************************************************************/
static  void  Proc1SecTask(void)
{ 
  if(Get1SecFlag()) //判断1s标志位状态
  {
		rtc_show_time();
    
    Clr1SecFlag();  //清除1s标志位
  }    
}

/*********************************************************************************************************
* 函数名称：main
* 函数功能：主函数 
* 输入参数：void
* 输出参数：void
* 返 回 值：int
* 创建日期：2022年01月01日
* 注    意：
*********************************************************************************************************/
int main(void)
{  
  InitHardware();   //初始化硬件相关函数
  InitSoftware();   //初始化软件相关函数

  printf("Init System has been finished.\r\n" );  //打印系统状态

	OLED_ShowChinese(0,0,3,16);   //电
	OLED_ShowChinese(16,0,4,16);  //子
	OLED_ShowChinese(32,0,5,16);  //科
	OLED_ShowChinese(48,0,6,16);  //技
	OLED_Refresh();
	
	printf("FlashID: 0x%08x\r\n", spi_flash_read_id());
  
  while(1)
  {  
    Proc2msTask();  //2ms处理任务
    Proc1SecTask(); //1s处理任务
  }
}
