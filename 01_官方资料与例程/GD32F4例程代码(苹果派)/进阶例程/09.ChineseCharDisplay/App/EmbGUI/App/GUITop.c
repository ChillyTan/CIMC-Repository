/*********************************************************************************************************
* 模块名称：GUITop.c
* 摘    要：顶层界面设计
* 当前版本：1.0.0
* 作    者：Leyutek(COPYRIGHT 2018 - 2021 Leyutek. All rights reserved.)
* 完成日期：2021年07月01日
* 内    容：
* 注    意：                                                                  
**********************************************************************************************************
* 取代版本：
* 作    者：
* 完成日期：
* 修改内容：
* 修改文件：
*********************************************************************************************************/

/*********************************************************************************************************
*                                              包含头文件
*********************************************************************************************************/
#include "GUITop.h"
#include "TLILCD.h"
#include "GUIPlatform.h"
#include "JPEG.h"
#include "BMP.h"
#include "GUIButton.h"
#include "stdio.h"

/*********************************************************************************************************
*                                              宏定义
*********************************************************************************************************/

/*********************************************************************************************************
*                                              枚举结构体
*********************************************************************************************************/

/*********************************************************************************************************
*                                              内部变量
*********************************************************************************************************/
static StructGUIDev* s_pGUIDev = NULL;

/*********************************************************************************************************
*                                              内部函数声明
*********************************************************************************************************/
static void DisplayBackground(void); //绘制背景

/*********************************************************************************************************
*                                              内部函数实现
*********************************************************************************************************/
/*********************************************************************************************************
* 函数名称：DisplayBackground
* 函数功能：绘制背景
* 输入参数：void
* 输出参数：void
* 返 回 值：void
* 创建日期：2021年07月01日
* 注    意：调用之前要确保LCD方向为横屏
*********************************************************************************************************/
static void DisplayBackground(void)
{
  //背景图片控制结构体
  StructJpegImage backgroundImage;

  //初始化backgroundImage
  backgroundImage.image = (u8*)s_arrJpegBackgroundImage;
  backgroundImage.size  = sizeof(s_arrJpegBackgroundImage) / sizeof(u8);

  //解码并显示图片
  DisplayJPEGInFlash(&backgroundImage, 0, 0);
}

/*********************************************************************************************************
*                                              API函数实现
*********************************************************************************************************/
/*********************************************************************************************************
* 函数名称：InitGUI
* 函数功能：初始化GUI
* 输入参数：dev：GUI设备结构体
* 输出参数：void
* 返 回 值：void
* 创建日期：2021年07月01日
* 注    意：书名使用12x24字体
*********************************************************************************************************/
void InitGUI(StructGUIDev* dev)
{
  u32 len, max, total, begin;

  //LCD竖屏显示
  LCDDisplayDir(LCD_SCREEN_VERTICAL);
  LCDClear(LCD_COLOR_WHITE);

  //绘制背景
  DisplayBackground();

  //创建按键
  InitGUIButton();

  //计算书名长度
  len = 0;
  while((0 != dev->bookName[len]) && ('\r' != dev->bookName[len]) && ('\n' != dev->bookName[len]))
  {
    len++;
  }

  //计算屏幕一行最多显示多少个字符
  max = g_structTLILCDDev.width[LCD_LAYER_FOREGROUND] / 12;

  //所需的像素点总数
  total = 12 * len;

  //计算起始显示像素点
  begin = (g_structTLILCDDev.width[LCD_LAYER_FOREGROUND] - total) / 2;

  //显示书名
  GUIDrawTextLine(begin, 15, (u32)dev->bookName, GUI_FONT_ASCII_24, NULL, GUI_COLOR_WHITE, 1, max);

  //保存设备指针
  s_pGUIDev = dev;
}

/*********************************************************************************************************
* 函数名称：GUITask
* 函数功能：GUI任务
* 输入参数：void
* 输出参数：void
* 返 回 值：void
* 创建日期：2021年07月01日
* 注    意：每隔20毫秒执行一次
*********************************************************************************************************/
void GUITask(void)
{
  EnumGUIButtons button;

  //按键扫描
  button = ScanGUIButton();
  if(GUI_BUTTON_NONE != button)
  {
    //前一页
    if(GUI_BUTTON_PREVIOUS == button)
    {
      if(NULL != s_pGUIDev->previousPageCallback)
      {
        s_pGUIDev->previousPageCallback();
      }
    }

    //后一页
    else if(GUI_BUTTON_NEXT == button)
    {
      if(NULL != s_pGUIDev->nextPageCallback)
      {
        s_pGUIDev->nextPageCallback();
      }
    }
  }
}
