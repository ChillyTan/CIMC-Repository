/*********************************************************************************************************
* 模块名称：Main.c
* 摘    要：主文件，包含软硬件初始化函数和main函数
* 当前版本：1.0.0
* 作    者：SZLY(COPYRIGHT 2018 - 2020 SZLY. All rights reserved.)
* 完成日期：2022年01月01日
* 内    容：
* 注    意：注意勾选Options for Target 'Target1'->Code Generation->Use MicroLIB，否则printf无法使用
**********************************************************************************************************
* 取代版本：
* 作    者：
* 完成日期：
* 修改内容：
* 修改文件：
*********************************************************************************************************/

/*********************************************************************************************************
*                                              包含头文件
*********************************************************************************************************/
#include "Main.h"
#include "gd32f470x_conf.h"
#include "SysTick.h"
#include "RCU.h"
#include "NVIC.h"
#include "Timer.h"
#include "UART0.h"
#include "LED.h"
#include "stdio.h"
#include "SDRAM.h"
#include "TLILCD.h"
#include "JPEG.h"
#include "BMP.h"
#include "Touch.h"
#include "KeyOne.h"
#include "ProcKeyOne.h"
#include "Malloc.h"
#include "ff.h"
#include "FontLib.h"
#include "AudioTop.h"

/*********************************************************************************************************
*                                              宏定义
*********************************************************************************************************/

/*********************************************************************************************************
*                                              内部变量
*********************************************************************************************************/
/*********************************************************************************************************
*                                              枚举结构体
*********************************************************************************************************/

/*********************************************************************************************************
*                                              内部函数声明
*********************************************************************************************************/
static void InitHardware(void);       //初始化硬件相关的模块
static void InitSoftware(void);       //初始化软件相关的模块
static void Proc1msTask(void);        //1ms任务
static void Proc2msTask(void);        //2ms处理任务
static void Proc1SecTask(void);       //1s处理任务
static void InitFatFs(void);          //挂载文件系统

/*********************************************************************************************************
*                                              内部函数实现
*********************************************************************************************************/
/*********************************************************************************************************
* 函数名称：InitHardware
* 函数功能：所有的硬件相关的模块初始化函数都放在此函数中
* 输入参数：void
* 输出参数：void
* 返 回 值：void
* 创建日期：2018年01月01日
* 注    意：
*********************************************************************************************************/
static  void  InitHardware(void)
{  
  SystemInit();        //系统初始化
  InitRCU();           //初始化RCC模块
  InitNVIC();          //初始化NVIC模块
  InitUART0(115200);   //初始化UART模块
  InitTimer();         //初始化Timer模块
  InitSysTick();       //初始化SysTick模块
	InitSDRAM();         //初始化SDRAM模块
}

/*********************************************************************************************************
* 函数名称：InitSoftware
* 函数功能：所有的软件相关的模块初始化函数都放在此函数中
* 输入参数：void
* 输出参数：void
* 返 回 值：void
* 创建日期：2018年01月01日
* 注    意：
*********************************************************************************************************/
static  void  InitSoftware(void)
{
  InitMemory(SRAMTCM);   //初始化TCMSRAM内存池
  InitMemory(SRAMIN);    //初始化ADDSRAM内存池
  InitMemory(SDRAMEX);    //初始化SDRAM内存池
  InitFatFs();           //挂载文件系统
  InitFontLib();         //初始化字库管理模块
	InitLED();             //初始化LED模块
  InitLCD();             //初始化LCD模块
  InitJPEG();            //初始化绘制JPEG模块
  InitBMP();             //初始化位图绘制模块
  InitTouch();           //初始化触摸屏模块
  InitKeyOne();          //初始化独立按键模块
  InitProcKeyOne();      //初始化ProcKeyOne模块
  InitAudioTop();        //初始化音频顶层模块
}

/*********************************************************************************************************
* 函数名称：Proc1msTask
* 函数功能：1ms处理任务 
* 输入参数：void
* 输出参数：void
* 返 回 值：void
* 创建日期：2021年07月01日
* 注    意：
*********************************************************************************************************/
static  void  Proc1msTask(void)
{
  static u8 s_iCnt = 0;
  if(Get1msFlag())
  {
    s_iCnt++;
    if(s_iCnt >= 20)
    {
      ScanTouch();  //触摸屏扫描
      s_iCnt = 0;
    }
    Clr1msFlag();
  }
}

/*********************************************************************************************************
* 函数名称：Proc2msTask
* 函数功能：2ms处理任务 
* 输入参数：void
* 输出参数：void
* 返 回 值：void
* 创建日期：2021年07月01日
* 注    意：
*********************************************************************************************************/
static  void  Proc2msTask(void)
{ 
  if(Get2msFlag())  //判断2ms标志状态
  { 
    //调用闪烁函数
    LEDFlicker(250);

    //独立按键扫描，用于控制喇叭输出
    ScanKeyOne(KEY_NAME_KEY1, ProcKeyUpKey1, ProcKeyDownKey1);

    //清除2ms标志
    Clr2msFlag();
  }
}

/*********************************************************************************************************
* 函数名称：Proc1SecTask
* 函数功能：1s处理任务 
* 输入参数：void
* 输出参数：void
* 返 回 值：void
* 创建日期：2021年07月01日
* 注    意：
*********************************************************************************************************/
static  void  Proc1SecTask(void)
{ 
  if(Get1SecFlag()) //判断1s标志状态
  {
    //printf("This is the first GD32F450 Project, by Zhangsan\r\n");
    Clr1SecFlag();  //清除1s标志
  }
}

/*********************************************************************************************************
* 函数名称：InitFatFs
* 函数功能：挂载文件系统
* 输入参数：void
* 输出参数：void
* 返 回 值：void
* 创建日期：2021年07月01日
* 注    意：
*          1、使用长文件名请将ffconf.h中的_USE_LFN开关打开
*             0表示不使用长文件名，
*             1表示长文件名指针（FILINFO->lfname）指向静态地址，需要用户自己创建静态数组或动态分配内存（自制的）
*             2表示长文件名指针（FILINFO->lfname）指向栈区，需要在启动文件中将栈区开辟得大一些，否则容易死机
*             3表示长文件名指针（FILINFO->lfname）指向堆区，需要在启动文件中将堆区开辟得大一些，
*              同时需要C语言官方malloc函数的支持（尚未验证）
*          2、长文件名使用的是UTF-16编码，这是Unicode的一种编码方式，而我们中文字库使用的是GBK编码
*             所以要先转换为GBK才可以使用，这就需要将添加cc936.c到工程中
*          3、cc936.c文件中有个常量数组很大，有171k字节，占用很大的Flash空间，可以考虑将这个数组储存在SPI Flash中
*             为了减化操作，当前SPI Flash中只存放了GBK字库（24x24），用户可以将cc936.c中的uni2oem[]转成bin文件
*             储存在SD卡中，然后由SD卡更新到SPI Flash中
*          4、SD卡SDIO使用DMA传输，但是外拓SRAM不在DMA传输范围，文件系统中读写缓冲区不能是在外拓SRAM
*********************************************************************************************************/
static void InitFatFs(void)
{
  FRESULT result;   //文件操作返回变量
  FATFS   fs[2];    //文件系统设备结构体

  //挂载文件系统
  result = f_mount(&fs[0], FS_VOLUME_SD, 1);
  if(result != FR_OK)
  {
    printf("挂载文件系统失败 (%d)\r\n", result);
  }
  else
  {
    printf("挂载文件系统成功\r\n");
  }
}

/*********************************************************************************************************
* 函数名称：main
* 函数功能：主函数 
* 输入参数：void
* 输出参数：void
* 返 回 值：int
* 创建日期：2018年01月01日
* 注    意：
*********************************************************************************************************/
int main(void)
{  
  InitHardware(); //初始化硬件相关函数
  InitSoftware(); //初始化软件相关函数

  while(1)
  {
    Proc1msTask();  //1ms处理任务
    Proc2msTask();  //2ms处理任务
    Proc1SecTask(); //1s处理任务
    AudioTopTask(); //音频轮询任务
  }
}
