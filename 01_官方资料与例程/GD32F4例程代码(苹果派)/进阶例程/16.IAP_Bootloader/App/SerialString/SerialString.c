/*********************************************************************************************************
* 模块名称：SerialString.c
* 摘    要：字符串处理模块
* 当前版本：1.0.0
* 作    者：Leyutek(COPYRIGHT 2018 - 2021 Leyutek. All rights reserved.)
* 完成日期：2021年07月01日
* 内    容：
* 注    意：Bootloarder专用，不要使用printf或sprintf等C语言官方库函数，
*          否则编译器会将C语言官方库编入Bootloarder中，使得Bootloarder程序占用空间大
**********************************************************************************************************
* 取代版本：
* 作    者：
* 完成日期：
* 修改内容：
* 修改文件：
*********************************************************************************************************/

/*********************************************************************************************************
*                                              包含头文件
*********************************************************************************************************/
#include "SerialString.h"
#include "UART0.h"

/*********************************************************************************************************
*                                              宏定义
*********************************************************************************************************/

/*********************************************************************************************************
*                                              枚举结构体
*********************************************************************************************************/

/*********************************************************************************************************
*                                              内部变量
*********************************************************************************************************/
//数值-ASCII码转换表
static const char s_arrNumTable[] = {'0', '1', '2', '3', '4', '5', '6', '7', '8', '9'};

//字符串转换缓冲区
static char s_arrStringBuf[MAX_STRING_CONVER_LEN];

/*********************************************************************************************************
*                                              内部函数声明
*********************************************************************************************************/

/*********************************************************************************************************
*                                              内部函数实现
*********************************************************************************************************/

/*********************************************************************************************************
*                                              API函数实现
*********************************************************************************************************/
/*********************************************************************************************************
* 函数名称：PutString
* 函数功能：串口输出一个字符串
* 输入参数：string：字符串
* 输出参数：void
* 返 回 值：void
* 创建日期：2021年07月01日
* 注    意：
*********************************************************************************************************/
void PutString(char* string)
{
  u32 len; //字符串长度

  //统计字符串长度
  len = 0;
  while(0 != string[len])
  {
    len++;
  }

  WriteUART0((unsigned char*)string, len);
}

/*********************************************************************************************************
* 函数名称：PutUint
* 函数功能：串口输出一个10进制无符号整型
* 输入参数：num：显示数值，width：显示宽度，不足补零
* 输出参数：void
* 返 回 值：void
* 创建日期：2021年07月01日
* 注    意：
*********************************************************************************************************/
void PutDecUint(u32 num, u32 width)
{
  u32 divisor;      //除数1、10、100、1000...
  u32 widthDivisor; //显示完整宽度需要的除数大小
  u32 needDivisor;  //显示完整数字需要的除数大小
  u32 stringCnt;    //字符串计数
  u32 digital;      //单个位数据

  //计算显示位宽下需要的除数大小
  widthDivisor = 1;
  while(width)
  {
    width--;
    widthDivisor = widthDivisor * 10;
  }
  widthDivisor = widthDivisor / 10;

  //计算显示完整数字需要的除数大小
  needDivisor = 1;
  while(num >= needDivisor)
  {
    needDivisor = needDivisor * 10;
  }
  needDivisor = needDivisor / 10;

  //确定除数初值
  if(widthDivisor > needDivisor)
  {
    divisor = widthDivisor;
  }
  else
  {
    divisor = needDivisor;
  }

  //字符串转换
  stringCnt = 0;
  while(1)
  {
    //已经到个位了
    if(1 == divisor)
    {
      digital = num;
      s_arrStringBuf[stringCnt++] = s_arrNumTable[digital];
      break;
    }
    else
    {
      digital = num / divisor; //取出高位
      num     = num % divisor; //将高位剔除
      divisor = divisor / 10;  //更新除数
      s_arrStringBuf[stringCnt++] = s_arrNumTable[digital]; //数值转ASCII码
    }
  }
  s_arrStringBuf[stringCnt] = 0;

  //输出
  PutString(s_arrStringBuf);
}

/*********************************************************************************************************
* 函数名称：PutDouble
* 函数功能：串口输出一个浮点数
* 输入参数：num：显示数值，pointNum：小数点位数
* 输出参数：void
* 返 回 值：void
* 创建日期：2021年07月01日
* 注    意：
*********************************************************************************************************/
void PutDouble(double num, u32 pointNum)
{
  u32 integer, decimal; //整数、小数转换结果
  u32 divisor;          //除数1、10、100、1000...

  //确定除数
  divisor = 1;
  while(pointNum)
  {
    pointNum--;
    divisor = divisor * 10;
  }

  //得到整数部分
  integer = (u32)num;

  //得到小数部分
  num = num * divisor;
  decimal = ((u32)num) % divisor;

  //显示
  PutDecUint(integer, 1); //整数部分
  PutString(".");         //小数点
  PutDecUint(decimal, 1); //小数部分
}
