/*********************************************************************************************************
* 模块名称：ProcKeyOne.c
* 摘    要：ProcKeyOne模块，进行独立按键处理模块初始化，以及独立按键处理函数实现
* 当前版本：1.0.0
* 作    者：Leyutek(COPYRIGHT 2018 - 2022 Leyutek. All rights reserved.)
* 完成日期：2022年01月01日    
* 内    容：
* 注    意：                                                                  
**********************************************************************************************************
* 取代版本：
* 作    者：
* 完成日期：
* 修改内容：
* 修改文件：
*********************************************************************************************************/

/*********************************************************************************************************
*                                              包含头文件
*********************************************************************************************************/
#include "ProcKeyOne.h"
#include "UART0.h"
#include "GD25QXX.h"
#include "SysTick.h"

/*********************************************************************************************************
*                                              宏定义
*********************************************************************************************************/

/*********************************************************************************************************
*                                              枚举结构体
*********************************************************************************************************/

/*********************************************************************************************************
*                                              内部变量
*********************************************************************************************************/
u8 writebuf1[256] = {0};
u8 writebuf2[256] = {0};
u8 readbuf[256] = {0};

u8 Var1 = 0x16;
u8 Var2 = 0;
u8 Var3 = 0;

/*********************************************************************************************************
*                                              内部函数声明
*********************************************************************************************************/

/*********************************************************************************************************
*                                              内部函数实现
*********************************************************************************************************/

/*********************************************************************************************************
*                                              API函数实现
*********************************************************************************************************/
/*********************************************************************************************************
* 函数名称：InitProcKeyOne
* 函数功能：初始化ProcKeyOne模块
* 输入参数：void
* 输出参数：void
* 返 回 值：void
* 创建日期：2022年01月01日
* 注    意：
*********************************************************************************************************/
void InitProcKeyOne(void)
{
  
}

/*********************************************************************************************************
* 函数名称：ProcKeyDownKey1
* 函数功能：处理按键按下的事件，即按键按下的响应函数 
* 输入参数：void
* 输出参数：void
* 返 回 值：void
* 创建日期：2022年01月01日
* 注    意：
*********************************************************************************************************/
void  ProcKeyDownKey1(void)
{  
  //printf("KEY1 PUSH DOWN\r\n");  //打印按键状态
  printf("write buf1 \r\n");
  
  for(int i = 0; i < 256; i++)
	{
		writebuf1[i] = i;
	}
  
  GD25Q16X4KErase(0);
	DelayNms(2);
	GD25Q16Write(writebuf1, 256, 0);
}

/*********************************************************************************************************
* 函数名称：ProcKeyUpKey1
* 函数功能：处理按键弹起的事件，即按键弹起的响应函数 
* 输入参数：void
* 输出参数：void
* 返 回 值：void
* 创建日期：2022年01月01日
* 注    意：
*********************************************************************************************************/
void  ProcKeyUpKey1(void)
{
  //printf("KEY1 RELEASE\r\n");   //打印按键状态
}

/*********************************************************************************************************
* 函数名称：ProcKeyDownKey2
* 函数功能：处理按键按下的事件，即按键按下的响应函数 
* 输入参数：void
* 输出参数：void
* 返 回 值：void
* 创建日期：2022年01月01日
* 注    意： 
*********************************************************************************************************/
void  ProcKeyDownKey2(void)
{
  //printf("KEY2 PUSH DOWN\r\n");   //打印按键状态
	printf("write buf2 \r\n");
  
  for(int i = 0; i < 256; i++)
	{
		if( i< 256/2)
		{
			writebuf2[i] = i;
		}
		else
		{
			writebuf2[i] = 255;
		}
	}
  
  GD25Q16X4KErase(0);
	DelayNms(2);
	GD25Q16Write(writebuf2, 256, 0);
}

/*********************************************************************************************************
* 函数名称：ProcKeyUpKey2
* 函数功能：处理按键弹起的事件，即按键弹起的响应函数 
* 输入参数：void
* 输出参数：void
* 返 回 值：void
* 创建日期：2022年01月01日
* 注    意：
*********************************************************************************************************/
void  ProcKeyUpKey2(void)
{
  //printf("KEY2 RELEASE\r\n");     //打印按键状态
}

/*********************************************************************************************************
* 函数名称：ProcKeyDownKey3
* 函数功能：处理按键按下的事件，即按键按下的响应函数 
* 输入参数：void
* 输出参数：void
* 返 回 值：void
* 创建日期：2022年01月01日
* 注    意：
*********************************************************************************************************/
void  ProcKeyDownKey3(void)
{
  //printf("KEY3 PUSH DOWN\r\n");   //打印按键状态
	printf("reading \r\n");
	GD25Q16Read(readbuf, 256, 0);
  
	for(int i = 0; i < 256; i++)
	{
		printf("%x ", readbuf[i]);
		if(i!=0 && i%16==0)
		{
			printf("\r\n");
		}
	}
  
  printf("\r\n");
}

/*********************************************************************************************************
* 函数名称：ProcKeyUpKey3
* 函数功能：处理按键弹起的事件，即按键弹起的响应函数 
* 输入参数：void
* 输出参数：void
* 返 回 值：void
* 创建日期：2022年01月01日
* 注    意：
*********************************************************************************************************/
void  ProcKeyUpKey3(void)
{  
  //printf("KEY3 RELEASE\r\n");     //打印按键状态
}
