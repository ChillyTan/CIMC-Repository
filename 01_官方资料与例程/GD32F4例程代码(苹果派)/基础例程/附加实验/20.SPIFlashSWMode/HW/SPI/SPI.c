/*********************************************************************************************************
* 模块名称：SPI.c
* 摘    要：SPI模块
* 当前版本：1.0.0
* 作    者：Leyutek(COPYRIGHT 2018 - 2021 Leyutek. All rights reserved.)
* 完成日期：2021年07月01日
* 内    容：
* 注    意：注意勾选Options for Target 'Target1'->Code Generation->Use MicroLIB，否则printf无法使用                                                                  
**********************************************************************************************************
* 取代版本：
* 作    者：
* 完成日期：
* 修改内容：
* 修改文件：
*********************************************************************************************************/

/*********************************************************************************************************
*                                              包含头文件
*********************************************************************************************************/
#include "SPI.h"
#include "stdio.h"

/*********************************************************************************************************
*                                              宏定义
*********************************************************************************************************/

/*********************************************************************************************************
*                                              内部变量
*********************************************************************************************************/

/*********************************************************************************************************
*                                              枚举结构体定义
*********************************************************************************************************/

/*********************************************************************************************************
*                                              内部函数声明
*********************************************************************************************************/
static void ConfigSPIGPIO(void);         //初始化SPI相关GPIO

/*********************************************************************************************************
*                                              内部函数实现
*********************************************************************************************************/
static void ConfigSPIGPIO(void)
{
	//使能RCU相关时钟
	rcu_periph_clock_enable(RCU_GPIOC);                                     
	rcu_periph_clock_enable(RCU_GPIOF);   
	
	//配置PC0
	gpio_mode_set(GPIOC, GPIO_MODE_OUTPUT, GPIO_PUPD_PULLUP, GPIO_PIN_0);         //上拉输出
  gpio_output_options_set(GPIOC, GPIO_OTYPE_PP, GPIO_OSPEED_MAX, GPIO_PIN_0);   //推挽输出
  gpio_bit_set(GPIOC, GPIO_PIN_0);                                              //将PE2默认状态设置为高电平
  
  //配置PF7
	gpio_mode_set(GPIOF, GPIO_MODE_OUTPUT, GPIO_PUPD_PULLUP, GPIO_PIN_7);         //上拉输出
  gpio_output_options_set(GPIOF, GPIO_OTYPE_PP, GPIO_OSPEED_MAX, GPIO_PIN_7);   //推挽输出
  gpio_bit_set(GPIOF, GPIO_PIN_7);                                              //将PB13默认状态设置为高电平
  
  //配置PF8       
  gpio_mode_set(GPIOF, GPIO_MODE_INPUT, GPIO_PUPD_NONE, GPIO_PIN_8);            //设置PB14为输入模式
  
  //配置PF9
	gpio_mode_set(GPIOF, GPIO_MODE_OUTPUT, GPIO_PUPD_PULLUP, GPIO_PIN_9);         //上拉输出
  gpio_output_options_set(GPIOF, GPIO_OTYPE_PP, GPIO_OSPEED_MAX, GPIO_PIN_9);   //推挽输出
  gpio_bit_set(GPIOF, GPIO_PIN_9);                                              //将PB15默认状态设置为高电平
}

/*********************************************************************************************************
* 函数名称：InitSPI
* 函数功能：初始化SPI设备
* 输入参数：void
* 输出参数：void
* 返 回 值：void
* 创建日期：2021年07月01日
* 注    意：
*********************************************************************************************************/    
void InitSPI(void)
{
  ConfigSPIGPIO();
  
  SET_SPI_NSS();
  CLR_SPI_SCK();
  SET_SPI_MOSI();
}

/*********************************************************************************************************
* 函数名称：Delayus
* 函数功能：us延时
* 输入参数：void
* 输出参数：void
* 返 回 值：void
* 创建日期：2021年07月01日
* 注    意：
*********************************************************************************************************/    
void Delayus(uint32_t nCount)
{
  nCount = nCount * 4;
  for(; nCount != 0; nCount--);
}

/*********************************************************************************************************
* 函数名称：SPISetMOSI
* 函数功能：设置MOSI引脚电平
* 输入参数：void
* 输出参数：void
* 返 回 值：void
* 创建日期：2021年07月01日
* 注    意：
*********************************************************************************************************/   
static void SPISetMOSI(u8 val)
{
  if(val)
  {
    SET_SPI_MOSI();
  }
  else
  {
    CLR_SPI_MOSI();
  }
}

/*********************************************************************************************************
* 函数名称：SPIReadWriteByte
* 函数功能：SPI读写函数
* 输入参数：val-传输数据
* 输出参数：RevData-接收数据
* 返 回 值：void
* 创建日期：2021年07月01日
* 注    意：
*********************************************************************************************************/ 
static u8 SPIReadWriteByte(u8 val)
{
  u8 i;
  u8  RevData = 0;

  for(i = 0; i < 8; i++)
  {
    CLR_SPI_SCK();
    SPISetMOSI(val & 0x80);
    Delayus(1);
    val <<= 1;
    SET_SPI_SCK();
    RevData <<= 1;
    RevData |= READ_SPI_MISO();
    Delayus(1);
  }
  
  return RevData;
}

/*********************************************************************************************************
* 函数名称：GD25Q16ReadWriteDate
* 函数功能：SPI FLASH 读写函数
* 输入参数：val-传输数据
* 输出参数：RevData-接收数据
* 返 回 值：void
* 创建日期：2021年07月01日
* 注    意：
*********************************************************************************************************/
u8 GD25Q16ReadWriteDate(u8 val)
{
  return SPIReadWriteByte(val);
}
