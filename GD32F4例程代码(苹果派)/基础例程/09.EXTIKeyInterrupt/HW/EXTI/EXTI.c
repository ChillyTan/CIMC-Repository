/*********************************************************************************************************
* 模块名称：EXTI.c
* 摘    要：EXTI模块
* 当前版本：1.0.0
* 作    者：Leyutek(COPYRIGHT 2018 - 2022 Leyutek. All rights reserved.)
* 完成日期：2022年01月01日
* 内    容：
* 注    意：                                                                  
**********************************************************************************************************
* 取代版本：
* 作    者：
* 完成日期：
* 修改内容：
* 修改文件：
*********************************************************************************************************/

/*********************************************************************************************************
*                                              包含头文件
*********************************************************************************************************/
#include "EXTI.h"
#include "gd32f470x_conf.h"

/*********************************************************************************************************
*                                              宏定义
*********************************************************************************************************/

/*********************************************************************************************************
*                                              枚举结构体
*********************************************************************************************************/

/*********************************************************************************************************
*                                              内部变量定义
*********************************************************************************************************/

/*********************************************************************************************************
*                                              内部函数声明
*********************************************************************************************************/
static void ConfigEXTIGPIO(void);   //配置EXTI的GPIO 
static void ConfigEXTI(void);       //配置EXTI

/*********************************************************************************************************
*                                              内部函数实现
*********************************************************************************************************/
/*********************************************************************************************************
* 函数名称：ConfigEXTIGPIO
* 函数功能：配置EXTI的GPIO 
* 输入参数：void 
* 输出参数：void
* 返 回 值：void
* 创建日期：2022年01月01日
* 注    意：
*********************************************************************************************************/
static void ConfigEXTIGPIO(void)
{
  //使能RCU相关时钟
  rcu_periph_clock_enable(RCU_GPIOA); //使能GPIOA的时钟
	rcu_periph_clock_enable(RCU_GPIOH); //使能GPIOH的时钟
  rcu_periph_clock_enable(RCU_GPIOG); //使能GPIOG的时钟
	
  gpio_mode_set(GPIOA, GPIO_MODE_INPUT, GPIO_PUPD_PULLDOWN, GPIO_PIN_0); //配置PA0为下拉输入
  gpio_mode_set(GPIOH, GPIO_MODE_INPUT, GPIO_PUPD_PULLUP  , GPIO_PIN_4); //配置PH4为上拉输入
  gpio_mode_set(GPIOG, GPIO_MODE_INPUT, GPIO_PUPD_PULLUP  , GPIO_PIN_3); //配置PG3为上拉输入
}

/*********************************************************************************************************
* 函数名称：ConfigEXTI
* 函数功能：配置EXTI
* 输入参数：void 
* 输出参数：void
* 返 回 值：void
* 创建日期：2022年01月01日
* 注    意：
*********************************************************************************************************/
static void ConfigEXTI(void)
{
  rcu_periph_clock_enable(RCU_SYSCFG); //使能SYSCFG时钟
 
  syscfg_exti_line_config(EXTI_SOURCE_GPIOA, EXTI_SOURCE_PIN0);  //连接PA0和EXTI0
  syscfg_exti_line_config(EXTI_SOURCE_GPIOH, EXTI_SOURCE_PIN4);  //连接PH4和EXTI4
  syscfg_exti_line_config(EXTI_SOURCE_GPIOG, EXTI_SOURCE_PIN3);  //连接PG3和EXTI3
  
  exti_init(EXTI_0, EXTI_INTERRUPT, EXTI_TRIG_RISING);   //配置中断线
  exti_init(EXTI_4, EXTI_INTERRUPT, EXTI_TRIG_FALLING);  //配置中断线
  exti_init(EXTI_3, EXTI_INTERRUPT, EXTI_TRIG_FALLING);  //配置中断线
  
  nvic_irq_enable(EXTI0_IRQn, 2, 2);   //使能外部中断线EXTI0并设置优先级
  nvic_irq_enable(EXTI4_IRQn, 2, 2);   //使能外部中断线EXTI4并设置优先级
	nvic_irq_enable(EXTI3_IRQn, 2, 2);   //使能外部中断线EXTI3并设置优先级

  exti_interrupt_flag_clear(EXTI_0);   //清除Line0上的中断标志位
  exti_interrupt_flag_clear(EXTI_4);   //清除Line4上的中断标志位
  exti_interrupt_flag_clear(EXTI_3);   //清除Line3上的中断标志位
} 

/*********************************************************************************************************
* 函数名称：EXTI0IRQHandler
* 函数功能：EXTI0的中断服务函数，对应KEY1
* 输入参数：void 
* 输出参数：void
* 返 回 值：void
* 创建日期：2022年01月01日
* 注    意：
*********************************************************************************************************/
void EXTI0_IRQHandler(void)
{
  if(RESET != exti_interrupt_flag_get(EXTI_0)) 
  {
    //LED1状态取反
    gpio_bit_write(GPIOB, GPIO_PIN_5, (bit_status)(1 - gpio_output_bit_get(GPIOB, GPIO_PIN_5)));
    
    exti_interrupt_flag_clear(EXTI_0);  //清除Line0上的中断标志位
  }
}

/*********************************************************************************************************
* 函数名称：EXTI4IRQHandler
* 函数功能：EXTI4的中断服务函数，对应KEY2
* 输入参数：void 
* 输出参数：void
* 返 回 值：void
* 创建日期：2022年01月01日
* 注    意：
*********************************************************************************************************/
void EXTI4_IRQHandler(void)
{
  if(RESET != exti_interrupt_flag_get(EXTI_4)) 
  {
    //LED2状态取反
    gpio_bit_write(GPIOI, GPIO_PIN_8, (bit_status)(1 - gpio_output_bit_get(GPIOI, GPIO_PIN_8)));
    
    exti_interrupt_flag_clear(EXTI_4);  //清除Line4上的中断标志位
  }
}

/*********************************************************************************************************
* 函数名称：EXTI3IRQHandler
* 函数功能：EXTI3的中断服务函数，对应KEY3
* 输入参数：void 
* 输出参数：void
* 返 回 值：void
* 创建日期：2022年01月01日
* 注    意：
*********************************************************************************************************/
void EXTI3_IRQHandler(void)
{
  if(RESET != exti_interrupt_flag_get(EXTI_3)) 
  {
    //LED1状态取反
    gpio_bit_write(GPIOB, GPIO_PIN_5, (bit_status)(1 - gpio_output_bit_get(GPIOB, GPIO_PIN_5)));
		//LED2状态取反
		gpio_bit_write(GPIOI, GPIO_PIN_8, (bit_status)(1 - gpio_output_bit_get(GPIOI, GPIO_PIN_8)));
    
    exti_interrupt_flag_clear(EXTI_3);  //清除Line3上的中断标志位
  }
}

/*********************************************************************************************************
*                                              API函数实现
*********************************************************************************************************/
/*********************************************************************************************************
* 函数名称：InitEXTI
* 函数功能：初始化EXTI模块
* 输入参数：void 
* 输出参数：void
* 返 回 值：void
* 创建日期：2022年01月01日
* 注    意：
*********************************************************************************************************/
void  InitEXTI(void)
{
  ConfigEXTIGPIO(); //配置EXTI的GPIO
  ConfigEXTI();     //配置EXTI
}
