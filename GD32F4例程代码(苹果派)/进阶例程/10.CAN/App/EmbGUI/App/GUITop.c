/*********************************************************************************************************
* 模块名称：GUITop.c
* 摘    要：顶层界面设计
* 当前版本：1.0.0
* 作    者：Leyutek(COPYRIGHT 2018 - 2021 Leyutek. All rights reserved.)
* 完成日期：2021年07月01日
* 内    容：
* 注    意：                                                                  
**********************************************************************************************************
* 取代版本：
* 作    者：
* 完成日期：
* 修改内容：
* 修改文件：
*********************************************************************************************************/

/*********************************************************************************************************
*                                              包含头文件
*********************************************************************************************************/
#include "GUITop.h"
#include "TLILCD.h"
#include "JPEG.h"
#include "GUIButton.h"
#include "GUILineEdit.h"
#include "GUITerminal.h"
#include "stdio.h"

/*********************************************************************************************************
*                                              宏定义
*********************************************************************************************************/

/*********************************************************************************************************
*                                              枚举结构体
*********************************************************************************************************/

/*********************************************************************************************************
*                                              内部变量
*********************************************************************************************************/
static StructGUIDev* s_pGUIDev = NULL;

/*********************************************************************************************************
*                                              内部函数声明
*********************************************************************************************************/
static void DisplayBackground(void); //绘制背景

/*********************************************************************************************************
*                                              内部函数实现
*********************************************************************************************************/
/*********************************************************************************************************
* 函数名称：DisplayBackground
* 函数功能：绘制背景
* 输入参数：void
* 输出参数：void
* 返 回 值：void
* 创建日期：2021年07月01日
* 注    意：调用之前要确保LCD方向为横屏
*********************************************************************************************************/
static void DisplayBackground(void)
{
  //背景图片控制结构体
  StructJpegImage backgroundImage;

  //初始化backgroundImage
  backgroundImage.image = (unsigned char*)s_arrJpegBackgroundImage;
  backgroundImage.size  = sizeof(s_arrJpegBackgroundImage) / sizeof(unsigned char);

  //解码并显示图片
  DisplayJPEGInFlash(&backgroundImage, 0, 0);
}

/*********************************************************************************************************
*                                              API函数实现
*********************************************************************************************************/
/*********************************************************************************************************
* 函数名称：InitGUI
* 函数功能：初始化GUI
* 输入参数：dev：GUI设备结构体
* 输出参数：void
* 返 回 值：void
* 创建日期：2021年07月01日
* 注    意：书名使用12x24字体
*********************************************************************************************************/
void InitGUI(StructGUIDev* dev)
{
  //LCD横屏显示
  LCDDisplayDir(LCD_SCREEN_HORIZONTAL);
  LCDClear(LCD_COLOR_BLUE2);

  //绘制背景
  DisplayBackground();

  //创建按键
  InitGUIButton();

  //创建行编辑模块
  InitGUILineEdit();

  //创建终端界面
  InitGUITerminal();
  ClearGUITerminal();

  //连接函数指针
  dev->clearTherminal = ClearGUITerminal;
  dev->showLine = ShowStringLineInGUITerminal;

//  //字符串为白色
//  s_iLCDPointColor = WHITE;

  //CONX显示
  if(NULL != dev->can)
  {
    LCDShowString(545, 58, 100, 16, LCD_FONT_16, LCD_TEXT_TRANS, LCD_COLOR_WHITE, NULL, (char*)dev->can);
  }

  //速度显示
  if(NULL != dev->speed)
  {
    LCDShowString(545, 83, 100, 16, LCD_FONT_16, LCD_TEXT_TRANS, LCD_COLOR_WHITE, NULL, (char*)dev->speed);
  }

  //标识符显示
  if(NULL != dev->id)
  {
    LCDShowString(690, 58, 100, 16, LCD_FONT_16, LCD_TEXT_TRANS, LCD_COLOR_WHITE, NULL, (char*)dev->id);
  }

  //掩码显示
  if(NULL != dev->mask)
  {
    LCDShowString(690, 83, 100, 16, LCD_FONT_16, LCD_TEXT_TRANS, LCD_COLOR_WHITE, NULL, (char*)dev->mask);
  }

  //保存设备指针
  s_pGUIDev = dev;
}

/*********************************************************************************************************
* 函数名称：GUITask
* 函数功能：GUI任务
* 输入参数：void
* 输出参数：void
* 返 回 值：void
* 创建日期：2021年07月01日
* 注    意：每隔20毫秒执行一次
*********************************************************************************************************/
void GUITask(void)
{
 const char s_arrButtonValue[16] = {'0', '1', '2', '3', '4', '5', '6', '7', '8', '9', 'A', 'B', 'C', 'D', 'E', 'F'};
 EnumGUIButtons button;
 char* data = NULL;
 u32   id   = 0;

 //按键扫描
 button = ScanGUIButton();
 if(GUI_BUTTON_NONE != button)
 {
   //发送处理
   if(GUI_BUTTON_SEND == button)
   {
     if((0 == GetGUILineEditDataResult(&data)) && (0 == GetGUILineEditIDResult(&id)))
     {
       if(NULL != s_pGUIDev->sendCallBack)
       {
         s_pGUIDev->sendCallBack(id, data);
       }
       
     }
   }

   //删除处理
   else if(GUI_BUTTON_BACK == button)
   {
     DelectGUILineEditTextChar();
   }

   //K0-KF按下
   else
   {
     AddGUILineEditText(s_arrButtonValue[button]);
   }
 }

 //行编辑模块扫描
 ScanGUILineEdit();
}
