/*********************************************************************************************************
* 模块名称：WM8978.c
* 摘    要：WM8978音频驱动模块
* 当前版本：1.0.0
* 作    者：SZLY(COPYRIGHT 2018 - 2020 SZLY. All rights reserved.)
* 完成日期：2020年01月01日
* 内    容：
* 注    意：
**********************************************************************************************************
* 取代版本：
* 作    者：
* 完成日期：
* 修改内容：
* 修改文件：
*********************************************************************************************************/

/*********************************************************************************************************
*                                              包含头文件
*********************************************************************************************************/
#include "WM8978.h"
#include "gd32f470x_conf.h"
#include "SysTick.h"
#include "IICCommon.h"
#include "stdio.h"

/*********************************************************************************************************
*                                              宏定义
*********************************************************************************************************/

/*********************************************************************************************************
*                                              枚举结构体
*********************************************************************************************************/

/*********************************************************************************************************
*                                              内部变量
*********************************************************************************************************/
//WM8978寄存器值缓存区(总共58个寄存器,0~57),占用116字节内存
//因为WM8978的IIC操作不支持读操作,所以在本地保存所有寄存器值
//写WM8978寄存器时,同步更新到本地寄存器值,读寄存器时,直接返回本地保存的寄存器值.
//注意:WM8978的寄存器值是9位的,所以要用u16来存储
static u16 s_arrWM8978RegValTable[58]=
{
  0x0000, 0x0000, 0x0000, 0x0000, 0x0050, 0x0000, 0x0140, 0x0000,
  0x0000, 0x0000, 0x0000, 0x00FF, 0x00FF, 0x0000, 0x0100, 0x00FF,
  0x00FF, 0x0000, 0x012C, 0x002C, 0x002C, 0x002C, 0x002C, 0x0000,
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  0x0001, 0x0001
};

//IIC通信设备结构体
static StructIICCommonDev s_structIICDev;

/*********************************************************************************************************
*                                              内部函数声明
*********************************************************************************************************/
static void ConfigIICGPIO(void);    //配置IIC的GPIO
static void ConfigSDAMode(u8 mode); //配置SDA输入输出
static void SetSCL(u8 state);       //时钟信号线SCL控制
static void SetSDA(u8 state);       //数据信号线SDA控制
static u8   GetSDA(void);           //获取SDA输入电平
static void Delay(u8 time);         //延时函数

/*********************************************************************************************************
*                                              内部函数实现
*********************************************************************************************************/
/*********************************************************************************************************
* 函数名称：ConfigIICGPIO
* 函数功能：配置IIC的GPIO
* 输入参数：void 
* 输出参数：void
* 返 回 值：void
* 创建日期：2021年07月01日
* 注    意：
*********************************************************************************************************/
static void ConfigIICGPIO(void)
{
  //使能RCU相关时钟
  rcu_periph_clock_enable(RCU_GPIOB);  //使能GPIOB的时钟
  
  //SCL
  gpio_mode_set(GPIOB, GPIO_MODE_OUTPUT, GPIO_PUPD_PULLUP, GPIO_PIN_6);      //上拉输出
  gpio_output_options_set(GPIOB, GPIO_OTYPE_PP, GPIO_OSPEED_MAX,GPIO_PIN_6); //推挽输出
  gpio_bit_set(GPIOB, GPIO_PIN_6);                                           //拉高SCL
  
  //SDA
  gpio_mode_set(GPIOB, GPIO_MODE_OUTPUT, GPIO_PUPD_PULLUP, GPIO_PIN_7);      //上拉输出
  gpio_output_options_set(GPIOB, GPIO_OTYPE_PP, GPIO_OSPEED_MAX,GPIO_PIN_7); //推挽输出
  gpio_bit_set(GPIOB, GPIO_PIN_7);                                           //拉高SCL
}

/*********************************************************************************************************
* 函数名称：ConfigSDAMode
* 函数功能：配置SDA输入输出
* 输入参数：mode：IIC_COMMON_INPUT、IIC_COMMON_OUTPUT 
* 输出参数：void
* 返 回 值：void
* 创建日期：2018年01月01日
* 注    意：
*********************************************************************************************************/
static void ConfigSDAMode(u8 mode)
{
  rcu_periph_clock_enable(RCU_GPIOB);  //使能GPIOB的时钟
  
  //配置成输出
  if(IIC_COMMON_OUTPUT == mode)
  {
    gpio_mode_set(GPIOB, GPIO_MODE_OUTPUT, GPIO_PUPD_PULLUP, GPIO_PIN_7);      //上拉输出
    gpio_output_options_set(GPIOB, GPIO_OTYPE_PP, GPIO_OSPEED_MAX,GPIO_PIN_7); //推挽输出
  }
  
  //配置成输入
  else if(IIC_COMMON_INPUT == mode)
  {
    gpio_mode_set(GPIOB, GPIO_MODE_INPUT, GPIO_PUPD_PULLUP, GPIO_PIN_7);       //上拉输入
  }
}

/*********************************************************************************************************
* 函数名称：SetSCL
* 函数功能：时钟信号线SCL控制
* 输入参数：state：0-输入低电平，1-输出高电平
* 输出参数：void
* 返 回 值：void
* 创建日期：2018年01月01日
* 注    意：
*********************************************************************************************************/
static void SetSCL(u8 state)
{
  if(1 == state)
  {
    gpio_bit_set(GPIOB, GPIO_PIN_6);
  }
  else
  {
    gpio_bit_reset(GPIOB, GPIO_PIN_6);
  }
}

/*********************************************************************************************************
* 函数名称：SetSDA
* 函数功能：数据信号线SDA控制
* 输入参数：state：0-输入低电平，1-输出高电平
* 输出参数：void
* 返 回 值：void
* 创建日期：2018年01月01日
* 注    意：
*********************************************************************************************************/
static void SetSDA(u8 state)
{
  if(1 == state)
  {
    gpio_bit_set(GPIOB, GPIO_PIN_7);
  }
  else
  {
    gpio_bit_reset(GPIOB, GPIO_PIN_7);
  }
}

/*********************************************************************************************************
* 函数名称：GetSDA
* 函数功能：获取SDA输入电平
* 输入参数：void 
* 输出参数：void
* 返 回 值：SDA输入电平
* 创建日期：2018年01月01日
* 注    意：
*********************************************************************************************************/
static u8 GetSDA(void)
{
  if(RESET == gpio_input_bit_get(GPIOB, GPIO_PIN_7))
  {
    return 0;
  }
  else
  {
    return 1;
  }
}

/*********************************************************************************************************
* 函数名称：Delay
* 函数功能：延时函数
* 输入参数：time：延时时钟周期
* 输出参数：void
* 返 回 值：SDA输入电平
* 创建日期：2018年01月01日
* 注    意：
*********************************************************************************************************/
static void Delay(u8 time)
{
  DelayNus(4 * time);
}

/*********************************************************************************************************
*                                              API函数实现
*********************************************************************************************************/
/*********************************************************************************************************
* 函数名称：InitWM8978
* 函数功能：WM8978初始化
* 输入参数：void 
* 输出参数：void
* 返 回 值：0-初始化成功，其它-失败
* 创建日期：2018年01月01日
* 注    意：
*********************************************************************************************************/
u8 InitWM8978(void)
{ 
  u8 res;

  //初始化IIC的GPIO
  ConfigIICGPIO();

  //配置IIC
  s_structIICDev.deviceID      = WM8978_ADDR << 1; //设备ID
  s_structIICDev.SetSCL        = SetSCL;           //设置SCL电平值
  s_structIICDev.SetSDA        = SetSDA;           //设置SDA电平值
  s_structIICDev.GetSDA        = GetSDA;           //获取SDA输入电平
  s_structIICDev.ConfigSDAMode = ConfigSDAMode;    //配置SDA输入输出方向
  s_structIICDev.Delay         = Delay;            //延时函数

  //软复位WM8978
  res = WM8978WriteReg(0, 0);
  if(0 != res)
  {
    printf("InitWM8978: Fail to reset WM8978!\r\n");
    return 1;
  }

  //以下为通用设置
  WM8978WriteReg(1, 0x1B);    //R1,MICEN设置为1(MIC使能),BIASEN设置为1(模拟器工作),VMIDSEL[1:0]设置为:11(5K)
  WM8978WriteReg(2, 0x1B0);   //R2,ROUT1,LOUT1输出使能(耳机可以工作),BOOSTENR,BOOSTENL使能
  WM8978WriteReg(3, 0x6C);    //R3,LOUT2,ROUT2输出使能(喇叭工作),RMIX,LMIX使能
  WM8978WriteReg(6, 0);       //R6,MCLK由外部提供
  WM8978WriteReg(43, 1 << 4); //R43,INVROUT2反向,驱动喇叭
  WM8978WriteReg(47, 1 << 8); //R47设置,PGABOOSTL,左通道MIC获得20倍增益
  WM8978WriteReg(48, 1 << 8); //R48设置,PGABOOSTR,右通道MIC获得20倍增益
  WM8978WriteReg(49, 1 << 1); //R49,TSDEN,开启过热保护 
  WM8978WriteReg(49, 1 << 2); //R49,SPEAKER BOOST,1.5x 
  WM8978WriteReg(10, 1 << 3); //R10,SOFTMUTE关闭,128x采样,最佳SNR 
  WM8978WriteReg(14, 1 << 3); //R14,ADC 128x采样率
  return 0;
}

/*********************************************************************************************************
* 函数名称：WM8978WriteReg
* 函数功能：写寄存器
* 输入参数：reg:寄存器地址，val:要写入寄存器的值
* 输出参数：void
* 返 回 值：0-成功，其它-失败
* 创建日期：2018年01月01日
* 注    意：
*********************************************************************************************************/
u8 WM8978WriteReg(u8 reg, u16 val)
{
  u8 writeReg, writeData;

  //写寄存器地址+数据的最高位
  writeReg = (reg << 1) | ((val >> 8) & 0x01);
  writeData = val & 0xFF;

  //写入
  if(0 != IICCommonWriteBytes(&s_structIICDev, writeReg, &writeData, 1))
  {
    //写入失败
    return 1;
  }

  //保存寄存器值到本地
  s_arrWM8978RegValTable[reg] = val;
  return 0;
}

/*********************************************************************************************************
* 函数名称：WM8978ReadReg
* 函数功能：读寄存器
* 输入参数：reg:寄存器地址
* 输出参数：void
* 返 回 值：寄存器值
* 创建日期：2018年01月01日
* 注    意：
*********************************************************************************************************/
u16 WM8978ReadReg(u8 reg)
{
  return s_arrWM8978RegValTable[reg];
}

/*********************************************************************************************************
* 函数名称：WM8978ADDACfg
* 函数功能：DAC/ADC配置
* 输入参数：adcen：adc使能(1)/关闭(0)
*          dacen：dac使能(1)/关闭(0)
* 输出参数：void
* 返 回 值：void
* 创建日期：2018年01月01日
* 注    意：
*********************************************************************************************************/
void WM8978ADDACfg(u8 dacen, u8 adcen)
{
  u16 regval;

  //设置DAC
  regval = WM8978ReadReg(3);
  if(dacen)
  {
    regval |= 3 << 0;
  }
  else
  {
    regval &= ~(3 << 0);
  }
  WM8978WriteReg(3,regval);

  //设置ADC
  regval=WM8978ReadReg(2);
  if(adcen)
  {
    regval |= 3 << 0;
  }
  else
  {
    regval &= ~(3 << 0);
  }
  WM8978WriteReg(2,regval);
}

/*********************************************************************************************************
* 函数名称：WM8978InputCfg
* 函数功能：输入通道配置
* 输入参数：micen:MIC开启(1)/关闭(0)
*          lineinen:Line In开启(1)/关闭(0)
*          auxen:aux开启(1)/关闭(0)
* 输出参数：void
* 返 回 值：void
* 创建日期：2018年01月01日
* 注    意：
*********************************************************************************************************/
void WM8978InputCfg(u8 micen, u8 lineinen, u8 auxen)
{
  u16 regval;

  //设置MIC通道
  regval = WM8978ReadReg(2);
  if(micen)
  {
    regval |= 3 << 2;
  }
  else 
  {
    regval &= ~(3 << 2);
  }
  WM8978WriteReg(2, regval);

  //设置Line In通道
  regval = WM8978ReadReg(44);
  if(micen)
  {
    regval |= (3 << 4) | (3 << 0);
  }
  else 
  {
    regval &= ~((3 << 4) | (3 << 0));
  }
  WM8978WriteReg(44, regval);

  //Line In增益
  if(lineinen)
  {
    WM8978LineinGain(5);
  }
  else 
  {
    WM8978LineinGain(0);	
  }

  //设置AUX增益
  if(auxen)
  {
    WM8978AUXGain(7);
  }
  else 
  {
    WM8978AUXGain(0);
  }
}

/*********************************************************************************************************
* 函数名称：WM8978OutputCfg
* 函数功能：WM8978 输出配置
* 输入参数：dacen:DAC输出(放音)开启(1)/关闭(0)
*          bpsen:Bypass输出(录音,包括MIC,LINE IN,AUX等)开启(1)/关闭(0)
* 输出参数：void
* 返 回 值：void
* 创建日期：2018年01月01日
* 注    意：
*********************************************************************************************************/
void WM8978OutputCfg(u8 dacen, u8 bpsen)
{
  u16 regval=0;

  //DAC输出配置
  if(dacen)
  {
    regval |= 1 << 0;
  }

  //Bypass输出
  if(bpsen)
  {
    regval |= 1 << 1; //BYPASS使能
    regval |= 5 << 2; //0dB增益
  }

  //配置
  WM8978WriteReg(50, regval);
  WM8978WriteReg(51, regval);
}

/*********************************************************************************************************
* 函数名称：WM8978MICGain
* 函数功能：MIC增益设置(不包括BOOST的20dB,MIC-->ADC输入部分的增益)
* 输入参数：gain:0~63,对应-12dB~35.25dB, 0.75dB/Step
* 输出参数：void
* 返 回 值：void
* 创建日期：2018年01月01日
* 注    意：
*********************************************************************************************************/
void WM8978MICGain(u8 gain)
{
  gain &= 0x3F;
  WM8978WriteReg(45, gain);            //R45，左通道PGA设置
  WM8978WriteReg(46, gain | (1 << 8)); //R46，右通道PGA设置
}

/*********************************************************************************************************
* 函数名称：WM8978LineinGain
* 函数功能：WM8978 L2/R2(也就是Line In)增益设置(L2/R2-->ADC输入部分的增益)
* 输入参数：gain:0~7,0表示通道禁止,1~7,对应-12dB~6dB,3dB/Step
* 输出参数：void
* 返 回 值：void
* 创建日期：2018年01月01日
* 注    意：
*********************************************************************************************************/
void WM8978LineinGain(u8 gain)
{
  u16 regval;
  gain &= 0x07;
  regval = WM8978ReadReg(47);
  regval &= ~(7 << 4);
  WM8978WriteReg(47, regval | gain << 4);
  regval = WM8978ReadReg(48);
  regval &= ~(7 << 4);
  WM8978WriteReg(48, regval | gain << 4);
}

/*********************************************************************************************************
* 函数名称：WM8978AUXGain
* 函数功能：AUXR,AUXL(PWM音频部分)增益设置(AUXR/L-->ADC输入部分的增益)
* 输入参数：gain:0~7,0表示通道禁止,1~7,对应-12dB~6dB,3dB/Step
* 输出参数：void
* 返 回 值：void
* 创建日期：2018年01月01日
* 注    意：
*********************************************************************************************************/
void WM8978AUXGain(u8 gain)
{
  u16 regval;
  gain &= 0x07;
  regval = WM8978ReadReg(47);
  regval &= ~(7 << 0);
  WM8978WriteReg(47, regval | gain << 0);
  regval = WM8978ReadReg(48);
  regval &= ~(7 << 0);
  WM8978WriteReg(48, regval | gain << 0);
}

/*********************************************************************************************************
* 函数名称：WM8978I2SCfg
* 函数功能：设置I2S工作模式
* 输入参数：fmt:0,LSB(右对齐);1,MSB(左对齐);2,飞利浦标准I2S;3,PCM/DSP
*          len:0,16位;1,20位;2,24位;3,32位
* 输出参数：void
* 返 回 值：void
* 创建日期：2018年01月01日
* 注    意：
*********************************************************************************************************/
void WM8978I2SCfg(u8 fmt, u8 len)
{
  fmt &= 0x03;
  len &= 0x03;
  WM8978WriteReg(4,(fmt << 3)|(len << 5));
}

/*********************************************************************************************************
* 函数名称：WM8978HPvolSet
* 函数功能：设置耳机左右声道音量
* 输入参数：voll:左声道音量(0~63)
*          volr:右声道音量(0~63)
* 输出参数：void
* 返 回 值：void
* 创建日期：2018年01月01日
* 注    意：
*********************************************************************************************************/
void WM8978HPvolSet(u8 voll, u8 volr)
{
  voll &= 0x3F;
  volr &= 0x3F;//限定范围

  //音量为0时,直接mute
  if(0 == voll)
  {
    voll |= 1 << 6;
  }
  if(0 == volr)
  {
    volr |= 1 << 6;
  }
  WM8978WriteReg(52, voll);            //R52,耳机左声道音量设置
  WM8978WriteReg(53, volr | (1 << 8)); //R53,耳机右声道音量设置,同步更新(HPVU=1)
}

/*********************************************************************************************************
* 函数名称：WM8978SPKvolSet
* 函数功能：设置喇叭音量
* 输入参数：volx:左声道音量(0~63)
* 输出参数：void
* 返 回 值：void
* 创建日期：2018年01月01日
* 注    意：
*********************************************************************************************************/
void WM8978SPKvolSet(u8 volx)
{ 
  volx &= 0X3F;//限定范围

  //音量为0时,直接mute
  if(0 == volx)
  {
    volx |= 1 << 6;
  }
  WM8978WriteReg(54, volx);            //R54,喇叭左声道音量设置
  WM8978WriteReg(55, volx | (1 << 8)); //R55,喇叭右声道音量设置,同步更新(SPKVU=1)	
}

/*********************************************************************************************************
* 函数名称：WM89783DSet
* 函数功能：设置3D环绕声
* 输入参数：depth:0~15(3D强度,0最弱,15最强)
* 输出参数：void
* 返 回 值：void
* 创建日期：2018年01月01日
* 注    意：
*********************************************************************************************************/
void WM89783DSet(u8 depth)
{ 
  depth &= 0xF;              //限定范围
  WM8978WriteReg(41, depth); //R41,3D环绕设置
}

/*********************************************************************************************************
* 函数名称：WM8978EQ3DDir
* 函数功能：设置EQ/3D作用方向
* 输入参数：dir:0,在ADC起作用，1,在DAC起作用(默认)
* 输出参数：void
* 返 回 值：void
* 创建日期：2018年01月01日
* 注    意：
*********************************************************************************************************/
void WM8978EQ3DDir(u8 dir)
{
  u16 regval; 
  regval=WM8978ReadReg(0X12);
  if(dir)
  {
    regval |= 1 << 8;
  }
  else 
  {
    regval &= ~(1 << 8);
  }
  WM8978WriteReg(18, regval);
}
