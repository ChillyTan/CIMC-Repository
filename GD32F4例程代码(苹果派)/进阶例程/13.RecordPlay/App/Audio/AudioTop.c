/*********************************************************************************************************
* 模块名称：AudioTop.c
* 摘    要：音频顶层模块
* 当前版本：1.0.0
* 作    者：Leyutek(COPYRIGHT 2018 - 2021 Leyutek. All rights reserved.)
* 完成日期：2021年07月01日
* 内    容：
* 注    意：                                                                  
**********************************************************************************************************
* 取代版本：
* 作    者：
* 完成日期：
* 修改内容：
* 修改文件：
*********************************************************************************************************/

/*********************************************************************************************************
*                                              包含头文件
*********************************************************************************************************/
#include "AudioTop.h"
#include "WM8978.h"
#include "GUITop.h"
#include "stdio.h"
#include "Recorder.h"
#include "WavPlayer.h"

/*********************************************************************************************************
*                                              宏定义
*********************************************************************************************************/

/*********************************************************************************************************
*                                              枚举结构体
*********************************************************************************************************/
//音频状态机
typedef enum
{
  AUDIO_IDLE,   //空闲
  AUDIO_RECORD, //正在录音
  AUDIO_PLAY,   //正在播放录音
}EnumAudioState;

/*********************************************************************************************************
*                                              内部变量
*********************************************************************************************************/
static StructGUIDev   s_structGUIDev;  //GUI设备结构体
static EnumAudioState s_enumAudioState = AUDIO_IDLE; //状态机

/*********************************************************************************************************
*                                              内部函数声明
*********************************************************************************************************/
static void PlayCallback(void);      //播放按钮回调函数，启动播放功能
static void RecordCallback(void);    //录音按钮回调函数，启动录音功能
static void PauseCallback(void);     //暂停按钮回调函数，暂停录音或播放

/*********************************************************************************************************
*                                              内部函数实现
*********************************************************************************************************/
/*********************************************************************************************************
* 函数名称：PlayCallback
* 函数功能：播放回调函数
* 输入参数：void
* 输出参数：void
* 返 回 值：void
* 创建日期：2021年07月01日
* 注    意：
*********************************************************************************************************/
static void PlayCallback(void)
{
  //切换到播放录音
  if(((AUDIO_IDLE == s_enumAudioState) || (AUDIO_RECORD == s_enumAudioState)) && IsRecorderIdle())
  {
    StartWavPlay();
    s_enumAudioState = AUDIO_PLAY;
  }

  else if(AUDIO_PLAY == s_enumAudioState)
  {
    StartWavPlay();
  }
}

/*********************************************************************************************************
* 函数名称：RecordCallback
* 函数功能：录音回调函数
* 输入参数：void
* 输出参数：void
* 返 回 值：void
* 创建日期：2021年07月01日
* 注    意：
*********************************************************************************************************/
static void RecordCallback(void)
{
  //切换到录音状态
  if(((AUDIO_IDLE == s_enumAudioState) || (AUDIO_PLAY == s_enumAudioState)) && IsRecorderIdle())
  {
    StartEndRecorder();
    s_enumAudioState = AUDIO_RECORD;
  }

  //结束录音
  else if(AUDIO_RECORD == s_enumAudioState)
  {
    StartEndRecorder();
  }
}

/*********************************************************************************************************
* 函数名称：PauseCallback
* 函数功能：暂停回调函数
* 输入参数：void
* 输出参数：void
* 返 回 值：void
* 创建日期：2021年07月01日
* 注    意：
*********************************************************************************************************/
static void PauseCallback(void)
{
  //播放录音状态
  if(AUDIO_PLAY == s_enumAudioState)
  {
    PauseWavPlay();
  }

  //录音状态
  else if(AUDIO_RECORD == s_enumAudioState)
  {
    PauseRecorder();
  }
}

/*********************************************************************************************************
*                                              API函数实现
*********************************************************************************************************/
/*********************************************************************************************************
* 函数名称：InitAudioTop
* 函数功能：初始化音频顶层模块
* 输入参数：void
* 输出参数：void
* 返 回 值：void
* 创建日期：2021年07月01日
* 注    意：
*********************************************************************************************************/
void InitAudioTop(void)
{
	//初始化WM8978模块
	InitWM8978(); 

  //不使用喇叭
  WM8978SPKvolSet(0);

  //初始化录音机
  InitRecorder();

  //初始化录音播放模块
  InitWavPlayer();

  //设置回调函数
  s_structGUIDev.playCallback   = PlayCallback;   //播放
  s_structGUIDev.recordCallback = RecordCallback; //录音
  s_structGUIDev.pauseCallback  = PauseCallback;  //暂停

  //初始化UI界面设计，绘制背景、创建按键
  InitGUI(&s_structGUIDev);

  //默认空闲状态
  s_enumAudioState = AUDIO_IDLE;
}

/*********************************************************************************************************
* 函数名称：AudioTopTask
* 函数功能：音频顶层模块轮询任务
* 输入参数：void
* 输出参数：void
* 返 回 值：void
* 创建日期：2021年07月01日
* 注    意：放到主函数的while(1)中
*********************************************************************************************************/
void AudioTopTask(void)
{
  GUITask(); //GUI任务

  //播放录音状态
  if(AUDIO_PLAY == s_enumAudioState)
  {
    WavPlayerPoll(); //录音播放轮询任务
  }

  //录音状态
  else if(AUDIO_RECORD == s_enumAudioState)
  {
    RecorderPoll();  //录音轮询任务
  }
}
