/*********************************************************************************************************
* 模块名称：GUITop.c
* 摘    要：顶层界面设计
* 当前版本：1.0.0
* 作    者：Leyutek(COPYRIGHT 2018 - 2021 Leyutek. All rights reserved.)
* 完成日期：2021年07月01日
* 内    容：
* 注    意：                                                                  
**********************************************************************************************************
* 取代版本：
* 作    者：
* 完成日期：
* 修改内容：
* 修改文件：
*********************************************************************************************************/

/*********************************************************************************************************
*                                              包含头文件
*********************************************************************************************************/
#include "GUITop.h"
#include "TLILCD.h"
#include "JPEG.h"
#include "GUIButton.h"
#include "GUILineEdit.h"
#include "GUITerminal.h"
#include "GUIPlatform.h"
#include "stdio.h"


/*********************************************************************************************************
*                                              宏定义
*********************************************************************************************************/

/*********************************************************************************************************
*                                              枚举结构体定义
*********************************************************************************************************/

/*********************************************************************************************************
*                                              内部变量
*********************************************************************************************************/
static StructGUIDev* s_pGUIDev = NULL;

/*********************************************************************************************************
*                                              内部函数声明
*********************************************************************************************************/
static void DisplayBackground(void); //绘制背景

/*********************************************************************************************************
*                                              内部函数实现
*********************************************************************************************************/
/*********************************************************************************************************
* 函数名称：DisplayBackground
* 函数功能：绘制背景
* 输入参数：void
* 输出参数：void
* 返 回 值：void
* 创建日期：2021年07月01日
* 注    意：调用之前要确保LCD方向为横屏
*********************************************************************************************************/
static void DisplayBackground(void)
{
  //背景图片控制结构体
  StructJpegImage backgroundImage;

  //初始化backgroundImage
  backgroundImage.image = (unsigned char*)s_arrJpegBackgroundImage;
  backgroundImage.size  = sizeof(s_arrJpegBackgroundImage) / sizeof(unsigned char);

  //解码并显示图片
  DisplayJPEGInFlash(&backgroundImage, 0, 0);
}

/*********************************************************************************************************
*                                              API函数实现
*********************************************************************************************************/
/*********************************************************************************************************
* 函数名称：InitGUI
* 函数功能：初始化GUI
* 输入参数：dev：GUI设备结构体
* 输出参数：void
* 返 回 值：void
* 创建日期：2021年07月01日
* 注    意：书名使用12x24字体
*********************************************************************************************************/
void InitGUI(StructGUIDev* dev)
{
  //LCD横屏显示
  LCDDisplayDir(LCD_SCREEN_HORIZONTAL);
  LCDClear(LCD_COLOR_BLUE);

  //绘制背景
  DisplayBackground();

  //创建按键
  InitGUIButton();

  //保存设备指针
  s_pGUIDev = dev;
}

/*********************************************************************************************************
* 函数名称：GUITask
* 函数功能：GUI任务
* 输入参数：void
* 输出参数：void
* 返 回 值：void
* 创建日期：2021年07月01日
* 注    意：每隔20毫秒执行一次
*********************************************************************************************************/
void GUITask(void)
{
  static u64 s_iSysLastTime = 0;
  static u64 s_iSysCurrentTime = 0;
  static u32 s_iLastKeyNum = 0;
  StructGUIButtonResult* button;

  //获取当前时间
  s_iSysCurrentTime = GUIGetSysTime();

  if((s_iSysCurrentTime - s_iSysLastTime) >= s_pGUIDev->scanTime)
  {
    s_iSysLastTime = s_iSysCurrentTime;

    //按键扫描
    button = ScanGUIButton();
    if((0 != button->num) || (s_iLastKeyNum != button->num))
    {
      if(NULL != s_pGUIDev->scanCallback)
      {
        s_pGUIDev->scanCallback(button);
      }
    }
    
    s_iLastKeyNum = button->num;
  }
}
