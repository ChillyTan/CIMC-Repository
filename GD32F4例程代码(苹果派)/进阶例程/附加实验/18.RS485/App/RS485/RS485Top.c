/*********************************************************************************************************
* 模块名称：RS485Top.c
* 摘    要：RS485实验应用层模块模块
* 当前版本：1.0.0
* 作    者：Leyutek(COPYRIGHT 2018 - 2021 Leyutek. All rights reserved.)
* 完成日期：2021年07月01日
* 内    容：
* 注    意：
**********************************************************************************************************
* 取代版本：
* 作    者：
* 完成日期：
* 修改内容：
* 修改文件：
*********************************************************************************************************/

/*********************************************************************************************************
*                                              包含头文件
*********************************************************************************************************/
#include "RS485Top.h"
#include "gd32f470x_conf.h"
#include "TLILCD.h"
#include "GUITop.h"
#include "stdio.h"
#include "UART5.h"
#include "Timer.h"
#include "SysTick.h"

/*********************************************************************************************************
*                                              宏定义
*********************************************************************************************************/

/*********************************************************************************************************
*                                              枚举结构体
*********************************************************************************************************/

/*********************************************************************************************************
*                                              内部变量
*********************************************************************************************************/
static StructGUIDev s_structGUIDev;          //GUI设备结构体

/*********************************************************************************************************
*                                              内部函数声明
*********************************************************************************************************/
static void ConfigRS485GPIO(void);  //配置RS485的GPIO
static void SendProc(char* string); //发送处理函数
static void ReadProc(void);         //读串口处理

/*********************************************************************************************************
*                                              内部函数实现
*********************************************************************************************************/

/*********************************************************************************************************
* 函数名称：ConfigRS485GPIO
* 函数功能：配置RS485的GPIO
* 输入参数：void
* 输出参数：void
* 返 回 值：void
* 创建日期：2021年07月01日
* 注    意：PB2低电平时接收输出使能，高电平时发送输出使能
*********************************************************************************************************/
static void ConfigRS485GPIO(void)
{
	//配置RS485控制引脚
  rcu_periph_clock_enable(RCU_GPIOB);
  gpio_mode_set(GPIOB, GPIO_MODE_OUTPUT, GPIO_PUPD_PULLUP, GPIO_PIN_2);
  gpio_output_options_set(GPIOB, GPIO_OTYPE_PP, GPIO_OSPEED_MAX, GPIO_PIN_2);
  gpio_bit_reset(GPIOB, GPIO_PIN_2);
}

/*********************************************************************************************************
* 函数名称：SendProc
* 函数功能：发送处理函数
* 输入参数：string：行输入结果
* 输出参数：void
* 返 回 值：void
* 创建日期：2021年07月01日
* 注    意：
*********************************************************************************************************/
static void SendProc(char* string)
{
  u8 i;        //发送计数
  u8 sendData; //发送数据

  //校验输入地址是否为空指针
  if(NULL == string)
  {
    return;
  }

  //使能发送输出
  gpio_bit_set(GPIOB, GPIO_PIN_2);

  //等待模块完成模式切换
  DelayNms(10);

  //通过UART5将数据发送出去
  i = 0;
  while(0 != *(string + i))
  {
    //获取需要发送的数据
    sendData = *(string + i);

    //通过串口发送出去
    WriteUART5(&sendData, 1);

    //发送计数加一
    i++;
  }

  //发送回车换行
  sendData = '\r';
  WriteUART5(&sendData, 1);
  sendData = '\n';
  WriteUART5(&sendData, 1);

  //等待发送完成
  DelayNms(10);

  //切换回接收模式
  gpio_bit_reset(GPIOB, GPIO_PIN_2);

  //等待模块完成模式切换
  DelayNms(10);
}
/*********************************************************************************************************
* 函数名称：ReadProc
* 函数功能：读串口处理
* 输入参数：void
* 输出参数：void
* 返 回 值：void
* 创建日期：2021年07月01日
* 注    意：每隔一段时间调用一次
*********************************************************************************************************/
static void ReadProc(void)
{
  static u8  s_arrReadBuf[48] = {0}; //接收缓冲区
  static u8  s_iReadCnt       = 0;   //接收计数
  static u64 s_iBeginTime     = 0;   //接收到第一个字符时的系统时间

  u8  readData;
  u64 time;

  //获取系统运行时间
  time = GetSysTime();

  //接收数据处理
  while(ReadUART5(&readData, 1))
  {
    //记录接收到第一个字符时的系统时间
    if(0 == s_iReadCnt)
    {
      s_iBeginTime = time;
    }

    //将数据储存到缓冲区
    s_arrReadBuf[s_iReadCnt] = readData;

    //接收计数加一
    s_iReadCnt = (s_iReadCnt + 1) % (sizeof(s_arrReadBuf) / sizeof(u8));

    //接收到回车换行
    if(s_iReadCnt >= 2)
    {
      if(('\r' == s_arrReadBuf[s_iReadCnt - 2]) && ('\n' == s_arrReadBuf[s_iReadCnt - 1]))
      {
        //加上字符串结尾
        s_arrReadBuf[s_iReadCnt] = 0;

        //接收计数清零
        s_iReadCnt = 0;

        //输出到终端显示
        s_structGUIDev.showLine((char*)s_arrReadBuf);
      }
    }
  }

  //超过250毫秒还没接收到回车换行则强制更新到终端显示
  if((s_iReadCnt > 0) && ((time - s_iBeginTime) > 250))
  {
    //加上字符串结尾
    s_arrReadBuf[s_iReadCnt] = 0;

    //接收计数清零
    s_iReadCnt = 0;

    //输出到终端显示
    s_structGUIDev.showLine((char*)s_arrReadBuf);
  }
}

/*********************************************************************************************************
*                                              API函数实现
*********************************************************************************************************/
/*********************************************************************************************************
* 函数名称：InitRS485Top
* 函数功能：初始化RS485实验应用层模块
* 输入参数：void
* 输出参数：void
* 返 回 值：void
* 创建日期：2021年07月01日
* 注    意：
*********************************************************************************************************/
void InitRS485Top(void)
{
	//配置RS485的GPIO
  ConfigRS485GPIO();
	
  //串口号显示
  s_structGUIDev.serialPort = "UART5";

  //波特率显示
  s_structGUIDev.baudRate = "115200";
	
  //发送回调函数
  s_structGUIDev.sendCallBack = SendProc;
	
	//初始化UI界面设计
  InitGUI(&s_structGUIDev);
}

/*********************************************************************************************************
* 函数名称：RS485TopTask
* 函数功能：RS485实验应用层模块任务
* 输入参数：void
* 输出参数：void
* 返 回 值：void
* 创建日期：2021年07月01日
* 注    意：每隔20毫秒执行一次
*********************************************************************************************************/
void RS485TopTask(void)
{
	ReadProc(); //接收串口数据并输出到终端
  GUITask();  //GUI任务
}
